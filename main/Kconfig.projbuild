## main/Kconfig.projbuild
```kconfig
menu "I2S Configuration"
    choice I2S_NUM
        prompt "I2S number"
        default I2S_NUM_0
        help
            Defines the I2S port for microphone data input.

        config I2S_NUM_0
            bool "I2S 0"
        config I2S_NUM_1
            bool "I2S 1"
    endchoice

    config I2S_DATA_GPIO
        int "I2S Data GPIO number"
        default 2
        help
            Set the GPIO number used for transmitting/receiving data from I2S.

    config I2S_WS_GPIO
        int "I2S Word select GPIO number"
        default 42
        help
            Set the GPIO number used for the word select line from I2S.

    config I2S_CLK_GPIO
        int "I2S Clock GPIO number"
        default 41
        help
            Set the GPIO number used for the clock line from I2S.
endmenu



    menu "LED Configuration"

        choice BLINK_LED
            prompt "Blink LED type"
            default BLINK_LED_GPIO if IDF_TARGET_ESP32
            default BLINK_LED_RMT
            help
                Defines the default peripheral for blink example
    
            config BLINK_LED_GPIO
                bool "GPIO"
            config BLINK_LED_RMT
                bool "RMT - Addressable LED"
        endchoice
    
        config BLINK_LED_RMT_CHANNEL
            depends on BLINK_LED_RMT
            int "RMT Channel"
            range 0 7
            default 0
            help
                Set the RMT peripheral channel.
                ESP32 RMT channel from 0 to 7
                ESP32-S2 RMT channel from 0 to 3
                ESP32-S3 RMT channel from 0 to 3
                ESP32-C3 RMT channel from 0 to 1
    
        config BLINK_GPIO
            int "Blink GPIO number"
            range 0 48
            default 8 if IDF_TARGET_ESP32C3 || IDF_TARGET_ESP32H2
            default 18 if IDF_TARGET_ESP32S2
            default 48 if IDF_TARGET_ESP32S3
            default 5
            help
                GPIO number (IOxx) to blink on and off or the RMT signal for the addressable LED.
                Some GPIOs are used for other purposes (flash connections, etc.) and cannot be used to blink.
    
        config BLINK_PERIOD
            int "Blink period in ms"
            range 10 3600000
            default 1000
            help
                Define the blinking period in milliseconds.
    
    endmenu
```
